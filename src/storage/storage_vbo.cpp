#include "storage_internal.h"

#include "../config.h"
#include "../session.h"
#include "time_format.h"

#include <Arduino.h>
#include <esp_timer.h>
#include <string.h>

extern SemaphoreHandle_t session_mutex;

namespace storage_internal {

void write_vbo_header(const char* track_name) {
    struct tm ti;
    bool have_time = getLocalTime(&ti, 0);

    char header_buf[512];
    int pos = 0;

    if (have_time) {
        pos += snprintf(header_buf + pos, sizeof(header_buf) - pos,
                        "File created on %02d/%02d/%04d at %02d:%02d:%02d\r\n",
                        ti.tm_mday, ti.tm_mon + 1, ti.tm_year + 1900,
                        ti.tm_hour, ti.tm_min, ti.tm_sec);
    } else {
        pos += snprintf(header_buf + pos, sizeof(header_buf) - pos,
                        "File created on 00/00/0000 at 00:00:00\r\n");
    }

    pos += snprintf(header_buf + pos, sizeof(header_buf) - pos, "\r\n");

    pos += snprintf(header_buf + pos, sizeof(header_buf) - pos,
                    "[header]\r\n"
                    "satellites\r\n"
                    "time\r\n"
                    "latitude\r\n"
                    "longitude\r\n"
                    "velocity kmh\r\n"
                    "heading\r\n"
                    "height\r\n"
                    "\r\n");

    pos += snprintf(header_buf + pos, sizeof(header_buf) - pos,
                    "[comments]\r\n"
                    "Generated by KartGPS v1.0\r\n"
                    "Log Rate (Hz) : %d.00\r\n"
                    "\r\n",
                    (int)app_config.gps_rate_hz);

    pos += snprintf(header_buf + pos, sizeof(header_buf) - pos,
                    "[session data]\r\n"
                    "name %s\r\n"
                    "\r\n",
                    track_name);

    pos += snprintf(header_buf + pos, sizeof(header_buf) - pos,
                    "[column names]\r\n"
                    "sats time lat long velocity heading height\r\n"
                    "\r\n");

    pos += snprintf(header_buf + pos, sizeof(header_buf) - pos,
                    "[data]\r\n");

    xSemaphoreTake(spi_mutex, portMAX_DELAY);
    s_vbo_file.write(header_buf, pos);
    s_vbo_file.flush();
    s_vbo_file.sync();
    xSemaphoreGive(spi_mutex);

    s_bytes_written += pos;
}

void format_vbo_line(const VboEntry* entry, char* buf, int buf_len) {
    double secs = timestamp_us_to_secs_since_midnight(entry->timestamp_us);
    char time_buf[16];
    format_hhmmss_thousandths(time_buf, sizeof(time_buf), secs);

    // Racelogic VBO spec is counter-intuitive: longitude is stored as
    // arc-minutes with WEST positive and EAST negative.  Do not "fix"
    // this sign into `lon_deg * 60.0` — it would break Circuit Tools
    // import for every Eastern-hemisphere track.
    // See docs/PRD.md §"VBO 坐标格式" and
    // https://en.racelogic.support/VBOX_Automotive/Knowledge_Base/VBOX_Latitude_and_Longitude_Calculations
    double lat_amin = entry->lat_deg * 60.0;
    double lon_amin = entry->lon_deg * -60.0;

    snprintf(buf, buf_len,
             "%03d %s %+012.5f %+012.5f %07.3f %06.2f %+09.2f\r\n",
             entry->satellites,
             time_buf,
             lat_amin,
             lon_amin,
             (double)entry->speed_kmh,
             (double)entry->heading_deg,
             (double)entry->height_m);
}

void set_session_epoch(int64_t first_timestamp_us) {
    s_session_epoch_us = first_timestamp_us;
    struct tm ti;
    if (getLocalTime(&ti, 0)) {
        s_session_epoch_tod = ti.tm_hour * 3600.0
                            + ti.tm_min * 60.0
                            + ti.tm_sec;
    } else {
        s_session_epoch_tod = 0.0;
    }
}

double timestamp_us_to_secs_since_midnight(int64_t timestamp_us) {
    double elapsed_s = (double)(timestamp_us - s_session_epoch_us) / 1000000.0;
    double tod = s_session_epoch_tod + elapsed_s;
    if (tod >= 86400.0) {
        tod -= 86400.0;
    }
    if (tod < 0.0) {
        tod += 86400.0;
    }
    return tod;
}

static const char* lap_status_label(uint8_t status) {
    switch (status) {
        case LAP_STATUS_TIMED:  return "TIMED";
        case LAP_STATUS_SLOW:   return "SLOW";
        case LAP_STATUS_SHORT:  return "SHORT";
        case LAP_STATUS_NO_REF: return "NO_REF";
        case LAP_STATUS_OUT:    return "OUT";
        default:                return "UNKNOWN";
    }
}

void write_laptiming_lines() {
    char line[160];

    // Same VBO sign convention as format_vbo_line: East longitude negative.
    double lat1 = s_session_track.start_finish.lat1_deg * 60.0;
    double lon1 = s_session_track.start_finish.lon1_deg * -60.0;
    double lat2 = s_session_track.start_finish.lat2_deg * 60.0;
    double lon2 = s_session_track.start_finish.lon2_deg * -60.0;
    snprintf(line, sizeof(line),
             "Start  %+012.5f %+012.5f %+012.5f %+012.5f Start / Finish\r\n",
             lat1, lon1, lat2, lon2);
    s_vbo_file.write(line, strlen(line));

    for (int i = 0; i < s_session_track.sector_count - 1; i++) {
        lat1 = s_session_track.sectors[i].lat1_deg * 60.0;
        lon1 = s_session_track.sectors[i].lon1_deg * -60.0;
        lat2 = s_session_track.sectors[i].lat2_deg * 60.0;
        lon2 = s_session_track.sectors[i].lon2_deg * -60.0;
        snprintf(line, sizeof(line),
                 "Split  %+012.5f %+012.5f %+012.5f %+012.5f Split %d\r\n",
                 lat1, lon1, lat2, lon2, i + 1);
        s_vbo_file.write(line, strlen(line));
    }

    // Per-lap records.  The RaceLogic VBO spec allows arbitrary free-form
    // lines in the [laptiming] section; Circuit Tools normally computes
    // lap times from the detection-line geometry plus the GPS stream, so
    // these lines are extra human-readable durability for tools that want
    // explicit records.  Format: key=value pairs so future readers can
    // parse without a full VBO grammar.
    //
    // Safe to read session_state.laps[] lock-free here: the only writer
    // (handle_lap_finish in session.cpp) runs on the same task that called
    // storage_end_session(), so no concurrent mutation is possible on
    // this critical path.
    int lap_count = session_state.lap_count;
    if (lap_count > MAX_LAPS_PER_SESSION) {
        lap_count = MAX_LAPS_PER_SESSION;
    }
    for (int i = 0; i < lap_count; i++) {
        const LapRecord* lap = &session_state.laps[i];
        int pos = snprintf(line, sizeof(line),
                           "Lap %d lap_time_ms=%ld status=%s sectors=",
                           lap->lap_number,
                           (long)lap->lap_time_ms,
                           lap_status_label(lap->status));
        int sectors_to_write = lap->sector_count;
        if (sectors_to_write > MAX_SECTORS) {
            sectors_to_write = MAX_SECTORS;
        }
        for (int si = 0; si < sectors_to_write && pos < (int)sizeof(line) - 1; si++) {
            int n = snprintf(line + pos, sizeof(line) - pos,
                             "%s%ld",
                             (si == 0) ? "" : ",",
                             (long)lap->sector_times_ms[si]);
            if (n <= 0) { break; }
            pos += n;
        }
        if (pos < (int)sizeof(line) - 2) {
            line[pos++] = '\r';
            line[pos++] = '\n';
            line[pos]   = '\0';
        } else {
            // Clamp: ensure CRLF terminator even if we ran out of room.
            line[sizeof(line) - 3] = '\r';
            line[sizeof(line) - 2] = '\n';
            line[sizeof(line) - 1] = '\0';
            pos = sizeof(line) - 1;
        }
        s_vbo_file.write(line, pos);
    }

    s_vbo_file.write("\r\n", 2);
}

void write_session_metadata_json(const char* vbo_path) {
    char json_path[PATH_BUF_LEN];
    strncpy(json_path, vbo_path, sizeof(json_path) - 1);
    json_path[sizeof(json_path) - 1] = '\0';
    char* dot = strrchr(json_path, '.');
    if (!dot) {
        return;
    }
    strncpy(dot, ".json", sizeof(json_path) - (dot - json_path) - 1);

    int laps = 0;
    int32_t best_ms = -1;
    int best_num = -1;
    if (xSemaphoreTake(session_mutex, pdMS_TO_TICKS(100)) == pdTRUE) {
        laps = session_state.lap_count;
        best_ms = session_state.best_lap_time_ms;
        best_num = session_state.best_lap_number;
        xSemaphoreGive(session_mutex);
    }

    char date_str[11] = {0};
    char time_str[9] = {0};
    if (strlen(s_session_start_ts) >= 15) {
        snprintf(date_str, sizeof(date_str), "%.4s-%.2s-%.2s",
                 s_session_start_ts, s_session_start_ts + 4,
                 s_session_start_ts + 6);
        snprintf(time_str, sizeof(time_str), "%.2s:%.2s:%.2s",
                 s_session_start_ts + 9, s_session_start_ts + 11,
                 s_session_start_ts + 13);
    }

    const char* vbo_name = strrchr(vbo_path, '/');
    vbo_name = vbo_name ? vbo_name + 1 : vbo_path;

    // Session duration in seconds, derived from the monotonic epoch set
    // at storage_start_session().  The previous implementation used
    // millis()/1000 — that is uptime, not session length, and the two
    // diverge the moment the device is used for anything before the
    // first recording.  `esp_timer_get_time() - s_session_epoch_us` is
    // microseconds since session start on the same clock source, so
    // dividing by 1_000_000 gives integer seconds of actual recording.
    int64_t session_duration_us = esp_timer_get_time() - s_session_epoch_us;
    if (session_duration_us < 0) {
        session_duration_us = 0;
    }
    unsigned long total_time_s =
        (unsigned long)(session_duration_us / 1000000);

    char buf[384];
    int pos = snprintf(buf, sizeof(buf),
        "{\n"
        "  \"track\": \"%s\",\n"
        "  \"date\": \"%s\",\n"
        "  \"start_time\": \"%s\",\n"
        "  \"laps\": %d,\n"
        "  \"best_lap_ms\": %ld,\n"
        "  \"best_lap_number\": %d,\n"
        "  \"total_time_s\": %lu,\n"
        "  \"vbo_file\": \"%s\"\n"
        "}\n",
        s_active_track_name,
        date_str, time_str,
        laps, (long)best_ms, best_num,
        total_time_s,
        vbo_name);

    if (pos <= 0 || pos >= (int)sizeof(buf)) {
        Serial.println("[storage] WARN: metadata JSON too large, skipped");
        return;
    }

    xSemaphoreTake(spi_mutex, portMAX_DELAY);
    FsFile jf;
    bool ok = jf.open(json_path, O_WRONLY | O_CREAT | O_TRUNC);
    if (ok) {
        jf.write(buf, strlen(buf));
        jf.flush();
        jf.sync();
        jf.close();
    }
    xSemaphoreGive(spi_mutex);

    if (ok) {
        Serial.printf("[storage] metadata written: %s\n", json_path);
    } else {
        Serial.printf("[storage] WARN: failed to write metadata %s\n", json_path);
    }
}

void flush_and_sync() {
    xSemaphoreTake(spi_mutex, portMAX_DELAY);
    s_vbo_file.flush();
    s_vbo_file.sync();
    xSemaphoreGive(spi_mutex);
}

}  // namespace storage_internal
